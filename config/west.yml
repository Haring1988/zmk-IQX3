## config/west.yml
```yaml
manifest:
  remotes:
    - name: zmkfirmware
      url-base: https://github.com/petejohanson
  projects:
    - name: zmk
      remote: zmk
      revision: v0.3.0
      import: app/west.yml
  self:
    path: config
    
```
